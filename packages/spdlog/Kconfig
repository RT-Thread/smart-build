## packages/webclient/source/Kconfig
```kconfig
config PKGS_DIR
    string
    option env="PKGS_ROOT"
    default "packages"

config RT_VER_NUM
    hex
    default 0x50100

menu "webclient"

config PACKAGE_WEBCLIENT
    bool "Enable webclient"
    help
      Independent RT-Thread SCons webclient HTTP client example
    select PKG_USING_WEBCLIENT

source "$PKGS_DIR/Kconfig"

endmenu
```

## packages/webnet/source/Kconfig
```kconfig
config PKGS_DIR
    string
    option env="PKGS_ROOT"
    default "packages"

config RT_VER_NUM
    hex
    default 0x50100

menu "webnet"

config PACKAGE_WEBNET
    bool "Enable webnet"
    select PKG_USING_WEBNET

source "$PKGS_DIR/Kconfig"

endmenu
```

## rootfs/Kconfig
```kconfig
menu "Root filesystem"

choice
    prompt "Root filesystem type"
    default ROOTFS_MINIMAL

config ROOTFS_MINIMAL
    bool "Minimal rootfs"

config ROOTFS_BASIC
    bool "Basic rootfs (BusyBox)"

config ROOTFS_FULL
    bool "Full rootfs"

config ROOTFS_NONE
    bool "Disable Smart rootfs"

endchoice

config ROOTFS
    string
    default "minimal" if ROOTFS_MINIMAL
    default "basic" if ROOTFS_BASIC
    default "full" if ROOTFS_FULL
    default "none" if ROOTFS_NONE

source "rootfs/minimal/Kconfig"
source "rootfs/busybox/Kconfig"
source "rootfs/full/Kconfig"

endmenu
```

## rootfs/full/Kconfig
```kconfig
config ROOTFS_FULL
    bool "Full rootfs"

if ROOTFS_FULL

choice
    prompt "Rootfs build mode"
    default ROOTFS_FULL_BUILD_MODE_MIXED

config ROOTFS_FULL_BUILD_MODE_STATIC
    bool "Static applications"

config ROOTFS_FULL_BUILD_MODE_DYNAMIC
    bool "Dynamic applications"

config ROOTFS_FULL_BUILD_MODE_MIXED
    bool "Static and dynamic applications"

endchoice

config ROOTFS_BUILD_MODE
    string
    default "static" if ROOTFS_FULL_BUILD_MODE_STATIC
    default "dynamic" if ROOTFS_FULL_BUILD_MODE_DYNAMIC
    default "mixed" if ROOTFS_FULL_BUILD_MODE_MIXED

choice
    prompt "Full rootfs profile"
    default ROOTFS_PROFILE_BASE

config ROOTFS_PROFILE_BASE
    bool "Base package set"

config ROOTFS_PROFILE_DEVEL
    bool "Development package set"

config ROOTFS_PROFILE_FULL
    bool "Full package set"

endchoice

config ROOTFS_PROFILE
    string
    default "base" if ROOTFS_PROFILE_BASE
    default "devel" if ROOTFS_PROFILE_DEVEL
    default "full" if ROOTFS_PROFILE_FULL

choice
    prompt "Rootfs image format"
    default ROOTFS_FULL_IMAGE_FORMAT_EXT4

config ROOTFS_FULL_IMAGE_FORMAT_EXT4
    bool "ext4"

config ROOTFS_FULL_IMAGE_FORMAT_FAT
    bool "FAT"

config ROOTFS_FULL_IMAGE_FORMAT_ROMFS
    bool "romfs"

endchoice

config ROOTFS_IMAGE_FORMAT
    string
    default "ext4" if ROOTFS_FULL_IMAGE_FORMAT_EXT4
    default "fat" if ROOTFS_FULL_IMAGE_FORMAT_FAT
    default "romfs" if ROOTFS_FULL_IMAGE_FORMAT_ROMFS

choice
    prompt "Rootfs image size"
    depends on !ROOTFS_FULL_IMAGE_FORMAT_ROMFS
    default ROOTFS_FULL_IMAGE_SIZE_MB_16

config ROOTFS_FULL_IMAGE_SIZE_MB_1
    bool "1 MB"

config ROOTFS_FULL_IMAGE_SIZE_MB_4
    bool "4 MB"

config ROOTFS_FULL_IMAGE_SIZE_MB_8
    bool "8 MB"

config ROOTFS_FULL_IMAGE_SIZE_MB_16
    bool "16 MB"

config ROOTFS_FULL_IMAGE_SIZE_MB_32
    bool "32 MB"

config ROOTFS_FULL_IMAGE_SIZE_MB_64
    bool "64 MB"

config ROOTFS_FULL_IMAGE_SIZE_MB_128
    bool "128 MB"

config ROOTFS_FULL_IMAGE_SIZE_MB_256
    bool "256 MB"

config ROOTFS_FULL_IMAGE_SIZE_MB_512
    bool "512 MB"

config ROOTFS_FULL_IMAGE_SIZE_MB_1024
    bool "1024 MB"

endchoice

config ROOTFS_IMAGE_SIZE_MB
    string
    default "1" if ROOTFS_FULL_IMAGE_SIZE_MB_1
    default "4" if ROOTFS_FULL_IMAGE_SIZE_MB_4
    default "8" if ROOTFS_FULL_IMAGE_SIZE_MB_8
    default "16" if ROOTFS_FULL_IMAGE_SIZE_MB_16
    default "32" if ROOTFS_FULL_IMAGE_SIZE_MB_32
    default "64" if ROOTFS_FULL_IMAGE_SIZE_MB_64
    default "128" if ROOTFS_FULL_IMAGE_SIZE_MB_128
    default "256" if ROOTFS_FULL_IMAGE_SIZE_MB_256
    default "512" if ROOTFS_FULL_IMAGE_SIZE_MB_512
    default "1024" if ROOTFS_FULL_IMAGE_SIZE_MB_1024

choice
    prompt "Rootfs image size mode"
    depends on ROOTFS_FULL_IMAGE_FORMAT_EXT4
    default ROOTFS_FULL_IMAGE_SIZE_MODE_EXPANDABLE

config ROOTFS_FULL_IMAGE_SIZE_MODE_FIXED
    bool "Fixed image"

config ROOTFS_FULL_IMAGE_SIZE_MODE_EXPANDABLE
    bool "Expandable image"

endchoice

config ROOTFS_IMAGE_SIZE_MODE
    string
    default "fixed" if ROOTFS_FULL_IMAGE_SIZE_MODE_FIXED
    default "expandable" if ROOTFS_FULL_IMAGE_SIZE_MODE_EXPANDABLE

menu "Packages"

config ROOTFS_PACKAGE_MODE
    string
    default "manual"

source "packages/Kconfig"

endmenu

endif
```

## rootfs/minimal/Kconfig
```kconfig
config ROOTFS_MINIMAL
    bool "Minimal rootfs"

if ROOTFS_MINIMAL

choice
    prompt "Rootfs build mode"
    default ROOTFS_MINIMAL_BUILD_MODE_MIXED

config ROOTFS_MINIMAL_BUILD_MODE_STATIC
    bool "Static applications"

config ROOTFS_MINIMAL_BUILD_MODE_DYNAMIC
    bool "Dynamic applications"

config ROOTFS_MINIMAL_BUILD_MODE_MIXED
    bool "Static and dynamic applications"

endchoice

config ROOTFS_BUILD_MODE
    string
    default "static" if ROOTFS_MINIMAL_BUILD_MODE_STATIC
    default "dynamic" if ROOTFS_MINIMAL_BUILD_MODE_DYNAMIC
    default "mixed" if ROOTFS_MINIMAL_BUILD_MODE_MIXED

choice
    prompt "Rootfs image format"
    default ROOTFS_MINIMAL_IMAGE_FORMAT_EXT4

config ROOTFS_MINIMAL_IMAGE_FORMAT_EXT4
    bool "ext4"

config ROOTFS_MINIMAL_IMAGE_FORMAT_FAT
    bool "FAT"

config ROOTFS_MINIMAL_IMAGE_FORMAT_ROMFS
    bool "romfs"

endchoice

config ROOTFS_IMAGE_FORMAT
    string
    default "ext4" if ROOTFS_MINIMAL_IMAGE_FORMAT_EXT4
    default "fat" if ROOTFS_MINIMAL_IMAGE_FORMAT_FAT
    default "romfs" if ROOTFS_MINIMAL_IMAGE_FORMAT_ROMFS

choice
    prompt "Rootfs image size"
    depends on !ROOTFS_MINIMAL_IMAGE_FORMAT_ROMFS
    default ROOTFS_MINIMAL_IMAGE_SIZE_MB_16

config ROOTFS_MINIMAL_IMAGE_SIZE_MB_1
    bool "1 MB"

config ROOTFS_MINIMAL_IMAGE_SIZE_MB_4
    bool "4 MB"

config ROOTFS_MINIMAL_IMAGE_SIZE_MB_8
    bool "8 MB"

config ROOTFS_MINIMAL_IMAGE_SIZE_MB_16
    bool "16 MB"

config ROOTFS_MINIMAL_IMAGE_SIZE_MB_32
    bool "32 MB"

config ROOTFS_MINIMAL_IMAGE_SIZE_MB_64
    bool "64 MB"

config ROOTFS_MINIMAL_IMAGE_SIZE_MB_128
    bool "128 MB"

config ROOTFS_MINIMAL_IMAGE_SIZE_MB_256
    bool "256 MB"

config ROOTFS_MINIMAL_IMAGE_SIZE_MB_512
    bool "512 MB"

config ROOTFS_MINIMAL_IMAGE_SIZE_MB_1024
    bool "1024 MB"

endchoice

config ROOTFS_IMAGE_SIZE_MB
    string
    default "1" if ROOTFS_MINIMAL_IMAGE_SIZE_MB_1
    default "4" if ROOTFS_MINIMAL_IMAGE_SIZE_MB_4
    default "8" if ROOTFS_MINIMAL_IMAGE_SIZE_MB_8
    default "16" if ROOTFS_MINIMAL_IMAGE_SIZE_MB_16
    default "32" if ROOTFS_MINIMAL_IMAGE_SIZE_MB_32
    default "64" if ROOTFS_MINIMAL_IMAGE_SIZE_MB_64
    default "128" if ROOTFS_MINIMAL_IMAGE_SIZE_MB_128
    default "256" if ROOTFS_MINIMAL_IMAGE_SIZE_MB_256
    default "512" if ROOTFS_MINIMAL_IMAGE_SIZE_MB_512
    default "1024" if ROOTFS_MINIMAL_IMAGE_SIZE_MB_1024

choice
    prompt "Rootfs image size mode"
    depends on ROOTFS_MINIMAL_IMAGE_FORMAT_EXT4
    default ROOTFS_MINIMAL_IMAGE_SIZE_MODE_EXPANDABLE

config ROOTFS_MINIMAL_IMAGE_SIZE_MODE_FIXED
    bool "Fixed image"

config ROOTFS_MINIMAL_IMAGE_SIZE_MODE_EXPANDABLE
    bool "Expandable image"

endchoice

config ROOTFS_IMAGE_SIZE_MODE
    string
    default "fixed" if ROOTFS_MINIMAL_IMAGE_SIZE_MODE_FIXED
    default "expandable" if ROOTFS_MINIMAL_IMAGE_SIZE_MODE_EXPANDABLE

endif
```
