## Kconfig
```kconfig
mainmenu "RT-Thread Smart Build Configuration"

source "boards/Kconfig"
source "rootfs/Kconfig"
```

## boards/Kconfig
```kconfig
choice
    prompt "Machine"
    default MACHINE_QEMU_VIRT_AARCH64

source "boards/qemu-virt-aarch64/Kconfig"
source "boards/qemu-virt-riscv64/Kconfig"
source "boards/qemu-vexpress-a9/Kconfig"

endchoice
```

## boards/qemu-vexpress-a9/Kconfig
```kconfig
config MACHINE_QEMU_VEXPRESS_A9
    bool "QEMU vexpress A9"

if MACHINE_QEMU_VEXPRESS_A9

config MACHINE
    string
    default "qemu-vexpress-a9"

config ARCH
    string
    default "arm"

config BSP
    string
    default "qemu-vexpress-a9"

menu "Cross toolchain"

config TOOLCHAIN
    string
    default "arm-linux-musleabi-gcc-stable" if TOOLCHAIN_QEMU_VEXPRESS_A9_7_3_0
    default "arm-linux-musleabi-gcc-latest" if TOOLCHAIN_QEMU_VEXPRESS_A9_12_2_0

choice
    prompt "Toolchain version"
    default TOOLCHAIN_QEMU_VEXPRESS_A9_7_3_0
    help
      Select the cross compiler version used for this machine. The selected
      release must be installed in Env SDK or downloaded to downloads/.

config TOOLCHAIN_QEMU_VEXPRESS_A9_7_3_0
    bool "GCC 7.3.0 (Env SDK)"

config TOOLCHAIN_QEMU_VEXPRESS_A9_12_2_0
    bool "GCC 12.2.0"

endchoice

config TOOLCHAIN_VERSION
    string
    default "7.3.0" if TOOLCHAIN_QEMU_VEXPRESS_A9_7_3_0
    default "12.2.0" if TOOLCHAIN_QEMU_VEXPRESS_A9_12_2_0

config TOOLCHAIN_PATH
    string "Custom toolchain path"
    default ""
    help
      Optional toolchain root used before Env SDK and the downloads cache.
      Leave empty to use the standard discovery order.

endmenu

endif
```

## boards/qemu-virt-aarch64/Kconfig
```kconfig
config MACHINE_QEMU_VIRT_AARCH64
    bool "QEMU virt AArch64"

if MACHINE_QEMU_VIRT_AARCH64

config MACHINE
    string
    default "qemu-virt-aarch64"

config ARCH
    string
    default "aarch64"

config BSP
    string
    default "qemu-virt64-aarch64"

menu "Cross toolchain"

config TOOLCHAIN
    string
    default "aarch64-linux-musleabi-gcc-latest" if TOOLCHAIN_QEMU_VIRT_AARCH64_12_2_0

choice
    prompt "Toolchain version"
    default TOOLCHAIN_QEMU_VIRT_AARCH64_12_2_0
    help
      Select the cross compiler version used for this machine. The selected
      release must be installed in Env SDK or downloaded to downloads/.

config TOOLCHAIN_QEMU_VIRT_AARCH64_12_2_0
    bool "GCC 12.2.0"

endchoice

config TOOLCHAIN_VERSION
    string
    default "12.2.0" if TOOLCHAIN_QEMU_VIRT_AARCH64_12_2_0

config TOOLCHAIN_PATH
    string "Custom toolchain path"
    default ""
    help
      Optional toolchain root used before Env SDK and the downloads cache.
      Leave empty to use the standard discovery order.

endmenu

endif
```

## boards/qemu-virt-riscv64/Kconfig
```kconfig
config MACHINE_QEMU_VIRT_RISCV64
    bool "QEMU virt RISC-V 64"

if MACHINE_QEMU_VIRT_RISCV64

config MACHINE
    string
    default "qemu-virt-riscv64"

config ARCH
    string
    default "riscv64"

config BSP
    string
    default "qemu-virt64-riscv"

menu "Cross toolchain"

config TOOLCHAIN
    string
    default "riscv64-linux-musleabi-gcc-latest" if TOOLCHAIN_QEMU_VIRT_RISCV64_12_2_0

choice
    prompt "Toolchain version"
    default TOOLCHAIN_QEMU_VIRT_RISCV64_12_2_0
    help
      Select the cross compiler version used for this machine. The selected
      release must be installed in Env SDK or downloaded to downloads/.

config TOOLCHAIN_QEMU_VIRT_RISCV64_12_2_0
    bool "GCC 12.2.0"

endchoice

config TOOLCHAIN_VERSION
    string
    default "12.2.0" if TOOLCHAIN_QEMU_VIRT_RISCV64_12_2_0

config TOOLCHAIN_PATH
    string "Custom toolchain path"
    default ""
    help
      Optional toolchain root used before Env SDK and the downloads cache.
      Leave empty to use the standard discovery order.

endmenu

endif
```
