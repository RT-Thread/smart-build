## meta-rt-smart/conf/layer.conf
```bitbake
# We have a conf and classes directory, add to BBPATH
BBPATH .= ":${LAYERDIR}"

# We have recipes-* directories, add to BBFILES
BBFILES += "${LAYERDIR}/recipes-*/*/*.bb \
            ${LAYERDIR}/recipes-*/*/*.bbappend"

BBFILE_COLLECTIONS += "rt-smart"
BBFILE_PATTERN_rt-smart = "^${LAYERDIR}/"
BBFILE_PRIORITY_rt-smart = "10"

LAYERDEPENDS_meta-rt-smart = "core"
LAYERSERIES_COMPAT_rt-smart = "styhead"

PATH := "${PATH}:/usr/local/sbin:/usr/local/bin:/sbin:/bin:/usr/sbin:/usr/bin:${TOPDIR}/toolchains/aarch64-linux-musleabi_for_x86_64-pc-linux-gnu/bin:${TOPDIR}/toolchains/aarch64-linux-musleabi_for_x86_64-pc-linux-gnu/aarch64-linux-musleabi/bin:${TOPDIR}/toolchains/riscv64-linux-musleabi_for_x86_64-pc-linux-gnu/bin:${TOPDIR}/toolchains/riscv64-linux-musleabi_for_x86_64-pc-linux-gnu/riscv64-linux-musleabi/bin"
```

## meta-rt-smart/recipes-kernel/rt-thread/env/packages/sdk/Kconfig
```kconfig
config TARGET_FILE
    string
    default ""

config HOSTOS
    string
    option env="HOSTOS"
    default "Linux"
    
rsource "$HOSTOS/Kconfig"
```

## meta-rt-smart/recipes-kernel/rt-thread/env/packages/sdk/Linux/aarch64-none-elf-gcc/Kconfig
```kconfig
# Kconfig file for package aarch64-none-elf-gcc
menuconfig PKG_USING_AARCH64_NONE_ELF_GCC
    bool "aarch64-none-elf-gcc toolchain"
    default n

if PKG_USING_AARCH64_NONE_ELF_GCC

    config PKG_AARCH64_NONE_ELF_GCC_PATH
        string
        default "sdk/Linux/aarch64-none-elf-gcc"

    choice
        prompt "Version"
        help
            Select the package version

        config PKG_USING_AARCH64_NONE_ELF_GCC_V132REL1
            bool "v13.2.rel1"
    endchoice

    config PKG_AARCH64_NONE_ELF_GCC_VER
       string
       default "v13.2.rel1"   if PKG_USING_AARCH64_NONE_ELF_GCC_V132REL1

endif
```

## meta-rt-smart/recipes-kernel/rt-thread/env/packages/sdk/Windows/arm-none-eabi-gcc/Kconfig
```kconfig
# Kconfig file for package arm-none-eabi-gcc
menuconfig PKG_USING_ARM_NONE_EABI_GCC
    bool "arm-none-eabi-gcc toolchain"
    default n

if PKG_USING_ARM_NONE_EABI_GCC

    config PKG_ARM_NONE_EABI_GCC_PATH
        string
        default "sdk/Windows/arm-none-eabi-gcc"

    choice
        prompt "Version"
        help
            Select the package version

        config PKG_USING_ARM_NONE_EABI_GCC_V132REL1
            bool "v13.2.rel1"

        config PKG_USING_ARM_NONE_EABI_GCC_V103
            bool "v10.3"

    endchoice

    config PKG_ARM_NONE_EABI_GCC_VER
       string
       default "v13.2.rel1" if PKG_USING_ARM_NONE_EABI_GCC_V132REL1
       default "v10.3"      if PKG_USING_ARM_NONE_EABI_GCC_V103

endif
```

## meta-rt-smart/recipes-kernel/rt-thread/env/packages/sdk/Windows/riscv-none-elf-gcc/Kconfig
```kconfig
# Kconfig file for package riscv-none-elf-gcc
menuconfig PKG_USING_RISCV_NONE_ELF_GCC
    bool "riscv-none-elf-gcc toolchain"
    default n

if PKG_USING_RISCV_NONE_ELF_GCC

    config PKG_RISCV_NONE_ELF_GCC_PATH
        string
        default "sdk/Windows/riscv-none-elf-gcc"

    choice
        prompt "Version"
        help
            Select the package version

        config PKG_USING_RISCV_NONE_ELF_GCC_V1230REL2_XPACK
            bool "v12.3.0-2-xpack"

    endchoice

    config PKG_RISCV_NONE_ELF_GCC_VER
       string
       default "v12.3.0-2-xpack" if PKG_USING_RISCV_NONE_ELF_GCC_V1230REL2_XPACK

endif
```

## meta-smart/conf/layer.conf
```bitbake
# We have a conf and classes directory, add to BBPATH
BBPATH .= ":${LAYERDIR}"

# We have recipes-* directories, add to BBFILES
BBFILES += "${LAYERDIR}/recipes-*/*/*.bb \
            ${LAYERDIR}/recipes-*/*/*.bbappend"

BBFILE_COLLECTIONS += "smart"
BBFILE_PATTERN_smart = "^${LAYERDIR}/"
BBFILE_PRIORITY_smart = "10"

LAYERDEPENDS_meta-smart = "core"
LAYERSERIES_COMPAT_smart = "styhead"

PATH := "${PATH}:/usr/local/sbin:/usr/local/bin:/sbin:/bin:/usr/sbin:/usr/bin:${TOPDIR}/toolchains/aarch64-linux-musleabi_for_x86_64-pc-linux-gnu/bin:${TOPDIR}/toolchains/aarch64-linux-musleabi_for_x86_64-pc-linux-gnu/aarch64-linux-musleabi/bin:${TOPDIR}/toolchains/riscv64-linux-musleabi_for_x86_64-pc-linux-gnu/bin:${TOPDIR}/toolchains/riscv64-linux-musleabi_for_x86_64-pc-linux-gnu/riscv64-linux-musleabi/bin"

# ignore connectivity check
CONNECTIVITY_CHECK_URIS = ""
```

## meta-smart/conf/machine/k230.conf
```bitbake
#@TYPE: Machine
#@NAME: K230
#@DESCRIPTION: Machine configuration for K230 RISC-V board

require conf/machine/include/riscv/tune-riscv.inc

# 内核配置
KERNEL_DEVICETREE = "k230.dtb"
KERNEL_IMAGETYPE = "Image"

# U-Boot 配置
UBOOT_MACHINE = "k230_defconfig"
UBOOT_DEVICETREE = "k230"

# 串口配置
SERIAL_CONSOLES = "115200;ttyS0"

# 镜像类型
IMAGE_FSTYPES = "ext4"

# 系统特性
MACHINE_FEATURES = ""
MACHINE_EXTRA_RRECOMMENDS = ""

# 工具链配置
TUNE_FEATURES:tune-riscv64 = "riscv64"
TUNE_CCARGS:tune-riscv64 = "-march=rv64gc -mabi=lp64"
```

## meta-smart/conf/machine/rk3500.conf
```bitbake
#@TYPE: Machine
#@NAME: RK3500
#@DESCRIPTION: Machine configuration for RK3500

require conf/machine/include/arm/armv8-2a/tune-cortexa55.inc

# 内核配置
KERNEL_DEVICETREE = "rockchip/rk3500.dtb"
KERNEL_IMAGETYPE = "Image"

# U-Boot 配置
UBOOT_MACHINE = "rk3500_defconfig"
UBOOT_DEVICETREE = "rk3500"

# 串口配置
SERIAL_CONSOLES = "115200;ttyS0"

# 镜像类型
IMAGE_FSTYPES = "ext4"

# 系统特性
MACHINE_FEATURES = ""
MACHINE_EXTRA_RRECOMMENDS = ""

# 工具链配置
TUNE_FEATURES:tune-cortexa55 = "aarch64 armv8a crc crypto"
TUNE_CCARGS:tune-cortexa55 = "-march=armv8.2-a+crc+crypto -mtune=cortex-a55" 
```

## models/Kconfig
```kconfig
# TARGET_FILE置空，不再生成rtconfig.h文件
config TARGET_FILE
    string
    default ""

mainmenu "Chip and Board Configuration"

#
# 厂商选择
#
choice
    prompt "Select Vendor"
    default VENDOR_QEMU

#config VENDOR_NXP
#    bool "NXP"
#    help
#      Select NXP vendor.

config VENDOR_ROCKCHIP
    bool "Rockchip"
    help
      Select Rockchip vendor.

config VENDOR_QEMU
    bool "QEMU"
    help
      Select QEMU vendor.

#config VENDOR_CVITEK
#    bool "Cvitek"
#    help
#      Select Cvitek vendor.

endchoice

#
# 根据选择的厂商配置芯片型号
#
if VENDOR_NXP
    choice
        prompt "Select Chip Model for NXP"
        default CHIP_MODEL_IMX

    config CHIP_MODEL_IMX
        bool "i.MX Chip"
        help
          Select i.MX series chips.

    config CHIP_MODEL_LPC
        bool "LPC Chip"
        help
          Select LPC series chips.

    config CHIP_MODEL_MCX
        bool "MCX Chip"
        help
          Select MCX series chips.

    endchoice

    #
    # 根据选择的芯片配置开发板
    #
    if CHIP_MODEL_IMX
        choice
            prompt "Select Development Board for i.MX Chips"
            default BOARD_IMX6ULL_SMART

        config BOARD_IMX6SX
            bool "i.MX6SX Development Board"
            help
              Select i.MX6SX development board.

        config BOARD_IMX6UL
            bool "i.MX6UL Development Board"
            help
              Select i.MX6UL development board.

        config BOARD_IMX6ULL_SMART
            bool "i.MX6ULL Smart Development Board"
            help
              Select i.MX6ULL Smart development board.

        config BOARD_IMXRT
            bool "i.MXRT Development Board"
            help
              Select i.MXRT development board.

        endchoice
    endif

    if CHIP_MODEL_LPC
        # 可以为 LPC 选择开发板
        choice
            prompt "Select Development Board for LPC Chips"
            default BOARD_LPC1

        config BOARD_LPC1
            bool "LPC Development Board 1"
            help
              Select LPC development board 1.

        config BOARD_LPC2
            bool "LPC Development Board 2"
            help
              Select LPC development board 2.

        endchoice
    endif

    if CHIP_MODEL_MCX
        # 可以为 MCX 选择开发板
        choice
            prompt "Select Development Board for MCX Chips"
            default BOARD_MCX1

        config BOARD_MCX1
            bool "MCX Development Board 1"
            help
              Select MCX development board 1.

        config BOARD_MCX2
            bool "MCX Development Board 2"
            help
              Select MCX development board 2.

        endchoice
    endif
endif

#
# 如果选择了 Rockchip，配置相应芯片和开发板
#
if VENDOR_ROCKCHIP
    choice
        prompt "Select Chip Model for Rockchip"
        default CHIP_MODEL_RK3500

    config CHIP_MODEL_RK3500
        bool "RK3500 Chip"
        help
          Select RK3500 chip.

    endchoice

    choice
        prompt "Select Development Board for RK3500"
        default BOARD_RK3500

    config BOARD_RK3500
        bool "RK3500 Development Board"
        help
          Select RK3500 development board.

    endchoice
endif

#
# 如果选择了 QEMU，配置相应的开发板
#
if VENDOR_QEMU
    choice
        prompt "Select Development Board for QEMU"
        default BOARD_VIRT64_AARCH64

    config BOARD_VIRT64_AARCH64
        bool "virt64 aarch64"
        help
          Select QEMU virt64 aarch64 development board.

    config BOARD_VEXPRESS_A9
        bool "vexpress A9"
        help
          Select QEMU vexpress A9 development board.

    endchoice
endif


#
# 可选内核来源，如果本地有rt-thread仓库，可以指定本地目录，xmake编译过程中将不会再次拉取rt-thread仓库
#
menu "Kernel Configuration"

choice KERNEL_SOURCE
    prompt "Select Kernel Source"
    help
      Choose how to provide the kernel source.
    default KERNEL_SOURCE_GIT

config KERNEL_SOURCE_GIT
    bool "Fetch from Git repository"
    help
      Fetch the kernel source from a Git repository.

config KERNEL_SOURCE_LOCAL
    bool "Use a local directory"
    help
      Use an existing kernel source directory on the local file system.

endchoice

config KERNEL_LOCAL_DIR
    string "Local Kernel Directory"
    default "/home/rtthread/rt-thread/"
    depends on KERNEL_SOURCE_LOCAL
    help
      Specify the path to the local kernel source directory. This option
      is only available if "Use a local directory" is selected above.

endmenu

#
# 选择开发板后，配置您想使用的 app
#
menu "Selection the desired apps Application"

config APP_BUSYBOX
    bool "busybox"
    help
      Select busybox application.

config FORCE_APP_BUSYBOX
    bool
    default y
    select APP_BUSYBOX

config APP_CPP
    bool "cpp"
    help
      Select cpp application.

config APP_FFMPEG
    bool "ffmpeg"
    help
      Select ffmpeg application.

config APP_HELLO
    bool "hello"
    help
      Select hello application.

config APP_MICROPYTHON
    bool "micropython"
    help
      Select micropython application.

config APP_PLAYER
    bool "player"
    help
      Select player application.

config APP_SHM_PING
    bool "shm_ping"
    help
      Select shm_ping application.

config APP_SHM_PONG
    bool "shm_pong"
    help
      Select shm_pong application.

config APP_SMART_FETCH
    bool "smart-fetch"
    help
      Select smart-fetch application.

config APP_UMAILBOX
    bool "umailbox"
    help
      Select umailbox application.

config APP_WEBCLIENT
    bool "webclient"
    help
      Select webclient application.

config APP_WEBSERVER
    bool "webserver"
    help
      Select webserver application.

config APP_ZLIB
    bool "zlib"
    help
      Select zlib application.

endmenu
```
